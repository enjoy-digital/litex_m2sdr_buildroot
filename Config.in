## Config.in
```kconfig
comment "LiteX-M2SDR"
source "$BR2_EXTERNAL_LITEX_M2SDR_BUILDROOT_PATH/package/litex_m2sdr/Config.in"
source "$BR2_EXTERNAL_LITEX_M2SDR_BUILDROOT_PATH/linux/Config.ext.in"

comment "SDR"
source "$BR2_EXTERNAL_LITEX_M2SDR_BUILDROOT_PATH/package/gnuradio_soapy/Config.in"
```

## configs/raspberrypi5_defconfig
```kconfig
BR2_aarch64=y
BR2_cortex_a76=y
BR2_PACKAGE_HOST_LINUX_HEADERS_CUSTOM_6_12=y
BR2_TOOLCHAIN_BUILDROOT_CXX=y
BR2_CCACHE=y
BR2_GLOBAL_PATCH_DIR="$(BR2_EXTERNAL_LITEX_M2SDR_BUILDROOT_PATH)/board/raspberrypi5/patches"
BR2_DOWNLOAD_FORCE_CHECK_HASHES=y
BR2_ROOTFS_DEVICE_CREATION_DYNAMIC_EUDEV=y
BR2_TARGET_GENERIC_ROOT_PASSWD="root"
BR2_SYSTEM_DHCP="eth0"
BR2_ROOTFS_POST_BUILD_SCRIPT="$(BR2_EXTERNAL_LITEX_M2SDR_BUILDROOT_PATH)/board/raspberrypi5/post-build.sh"
BR2_ROOTFS_POST_IMAGE_SCRIPT="$(BR2_EXTERNAL_LITEX_M2SDR_BUILDROOT_PATH)/board/raspberrypi5/post-image.sh"
BR2_LINUX_KERNEL=y
BR2_LINUX_KERNEL_CUSTOM_TARBALL=y
BR2_LINUX_KERNEL_CUSTOM_TARBALL_LOCATION="$(call github,raspberrypi,linux,ac69f097e1fba94502cbd36278db204120a37943)/linux-ac69f097e1fba94502cbd36278db204120a37943.tar.gz"
BR2_LINUX_KERNEL_DEFCONFIG="bcm2712"
BR2_LINUX_KERNEL_CONFIG_FRAGMENT_FILES="$(BR2_EXTERNAL_LITEX_M2SDR_BUILDROOT_PATH)/board/raspberrypi5/linux-4k-page-size.fragment"
BR2_LINUX_KERNEL_DTS_SUPPORT=y
BR2_LINUX_KERNEL_INTREE_DTS_NAME="broadcom/bcm2712-rpi-5-b broadcom/bcm2712d0-rpi-5-b"
BR2_LINUX_KERNEL_NEEDS_HOST_OPENSSL=y
BR2_LINUX_KERNEL_EXT_LITEX_M2SDR_DRIVER=y
BR2_PACKAGE_BUSYBOX_SHOW_OTHERS=y
BR2_PACKAGE_XZ=y
BR2_PACKAGE_RPI_FIRMWARE=y
BR2_PACKAGE_RPI_FIRMWARE_CONFIG_FILE="$(BR2_EXTERNAL_LITEX_M2SDR_BUILDROOT_PATH)/board/raspberrypi5/config_5.txt"
BR2_PACKAGE_RPI_FIRMWARE_CMDLINE_FILE="$(BR2_EXTERNAL_LITEX_M2SDR_BUILDROOT_PATH)/board/raspberrypi5/cmdline_5.txt"
BR2_PACKAGE_KMOD=y
BR2_PACKAGE_KMOD_TOOLS=y
BR2_TARGET_ROOTFS_EXT2=y
BR2_TARGET_ROOTFS_EXT2_4=y
BR2_TARGET_ROOTFS_EXT2_SIZE="120M"
# BR2_TARGET_ROOTFS_TAR is not set

# Rootfs customisation
BR2_ROOTFS_OVERLAY="$(BR2_EXTERNAL_LITEX_M2SDR_BUILDROOT_PATH)/board/overlay"

# Required tools to create the SD image
BR2_PACKAGE_HOST_DOSFSTOOLS=y
BR2_PACKAGE_HOST_GENIMAGE=y
BR2_PACKAGE_HOST_KMOD_XZ=y
BR2_PACKAGE_HOST_MTOOLS=y

# Packages
BR2_PACKAGE_HWDATA=y
BR2_PACKAGE_LITEX_M2SDR=y
BR2_PACKAGE_LITEX_M2SDR_SOAPYSDR=y
BR2_PACKAGE_OPENSSH=y
# BR2_PACKAGE_OPENSSH_CLIENT is not set
BR2_PACKAGE_PCIUTILS=y
BR2_PACKAGE_SOAPY_SDR=y
BR2_PACKAGE_SOAPY_SDR_APPS=y
BR2_PACKAGE_SOAPY_SDR_PYTHON=y
```

## package/litex_m2sdr/Config.in
```kconfig
config BR2_PACKAGE_LITEX_M2SDR
	bool "LiteX-M2SDR"
	help
	  LiteX-M2SDR

	  https://github.com/enjoy-digital/litex_m2sdr

if BR2_PACKAGE_LITEX_M2SDR

source "$BR2_EXTERNAL_LITEX_M2SDR_BUILDROOT_PATH/package/litex_m2sdr/litex_m2sdr_driver/Config.in"

endif
```

## package/litex_m2sdr/litex_m2sdr_driver/Config.in
```kconfig
# Prompt-less option, because this package is not doing anything
# except downloading the FB TFT sources. The real work is done by a
# Linux extension.
config BR2_PACKAGE_LITEX_M2SDR_DRIVER
	bool
	depends on BR2_LINUX_KERNEL
	help
	  LiteX-M2SDR

	  https://github.com/enjoy-digital/litex_m2sdr
```

## package/litex_m2sdr/litex_m2sdr_soapysdr/Config.in
```kconfig
comment "LiteX-M2SDR SoapySDR Module needs soapySDR"
	depends on !BR2_PACKAGE_SOAPY_SDR

config BR2_PACKAGE_LITEX_M2SDR_SOAPYSDR
	bool "LiteX-M2SDR SoapySDR Module"

	depends on BR2_PACKAGE_SOAPY_SDR
	select BR2_PACKAGE_LITEX_M2SDR_USER
	help
	  LiteX-M2SDR SoapySDR Module

	  https://github.com/enjoy-digital/litex_m2sdr

if BR2_PACKAGE_LITEX_M2SDR_SOAPYSDR

choice
	prompt "LiteX-M2SDR SoapySDR transport"
	default BR2_PACKAGE_LITEX_M2SDR_SOAPYSDR_LITEPCIE

config BR2_PACKAGE_LITEX_M2SDR_SOAPYSDR_LITEPCIE
	bool "LitePCIe"

config BR2_PACKAGE_LITEX_M2SDR_SOAPYSDR_LITEETH
	bool "LiteEth"

endchoice

endif
```

## package/litex_m2sdr/litex_m2sdr_user/Config.in
```kconfig
config BR2_PACKAGE_LITEX_M2SDR_USER
	bool "LiteX-M2SDR User Applications"
	select BR2_PACKAGE_FFMPEG
	select BR2_PACKAGE_LIBSAMPLERATE
	select BR2_PACKAGE_LIBSNDFILE
	help
	  LiteX-M2SDR User applications

	  https://github.com/enjoy-digital/litex_m2sdr
```
